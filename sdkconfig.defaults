## sdkconfig.defaults
```kconfig
# Rust often needs a bit of an extra main task stack size compared to C (the default is 3K)
CONFIG_ESP_MAIN_TASK_STACK_SIZE=8000
# Rust often needs a bit of an extra main task stack size compared to C (the default is 3K)
#CONFIG_ESP_MAIN_TASK_STACK_SIZE=18000

CONFIG_ESP32_SPIRAM_SUPPORT=y

# Use this to set FreeRTOS kernel tick frequency to 1000 Hz (100 Hz by default).
# This allows to use 1 ms granuality for thread sleeps (10 ms by default).
#CONFIG_FREERTOS_HZ=1000

# Workaround for https://github.com/espressif/esp-idf/issues/7631
#CONFIG_MBEDTLS_CERTIFICATE_BUNDLE=n
#CONFIG_MBEDTLS_CERTIFICATE_BUNDLE_DEFAULT_FULL=n

# Increase event stack size
CONFIG_ESP_SYSTEM_EVENT_TASK_STACK_SIZE=4096

#CONFIG_SCCB_CLK_FREQ = 100000
#
## https://github.com/espressif/esp32-camera/blob/master/examples/sdkconfig.defaults
#CONFIG_ESP32_DEFAULT_CPU_FREQ_240=y
#CONFIG_ESP32S2_DEFAULT_CPU_FREQ_240=y
#CONFIG_ESP32S3_DEFAULT_CPU_FREQ_240=y
#
#CONFIG_ESPTOOLPY_FLASHSIZE_4MB=y
#CONFIG_PARTITION_TABLE_OFFSET=0x10000
#
#CONFIG_FREERTOS_HZ=1000
#CONFIG_ESPTOOLPY_FLASHFREQ_80M=y
#CONFIG_ESPTOOLPY_FLASHMODE_QIO=y
#
#CONFIG_SPIRAM_SUPPORT=y
#CONFIG_ESP32S2_SPIRAM_SUPPORT=y
#CONFIG_ESP32S3_SPIRAM_SUPPORT=y
#CONFIG_SPIRAM_SPEED_80M=y
#CONFIG_RTCIO_SUPPORT_RTC_GPIO_DESC=y
```
